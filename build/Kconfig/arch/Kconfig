## build/Kconfig/arch/Kconfig
```kconfig
# Load Zephyr Arch Kconfig descriptions.
osource "/Users/dan.tudose/zephyrproject/zephyr/arch/rx/Kconfig"
osource "/Users/dan.tudose/zephyrproject/zephyr/arch/x86/Kconfig"
osource "/Users/dan.tudose/zephyrproject/zephyr/arch/xtensa/Kconfig"
osource "/Users/dan.tudose/zephyrproject/zephyr/arch/sparc/Kconfig"
osource "/Users/dan.tudose/zephyrproject/zephyr/arch/riscv/Kconfig"
osource "/Users/dan.tudose/zephyrproject/zephyr/arch/posix/Kconfig"
osource "/Users/dan.tudose/zephyrproject/zephyr/arch/mips/Kconfig"
osource "/Users/dan.tudose/zephyrproject/zephyr/arch/arm64/Kconfig"
osource "/Users/dan.tudose/zephyrproject/zephyr/arch/arm/Kconfig"
osource "/Users/dan.tudose/zephyrproject/zephyr/arch/arc/Kconfig"
```

## build/Kconfig/boards/Kconfig.defconfig
```kconfig
# Load Zephyr board defconfig descriptions.
osource "/Users/dan.tudose/zephyrproject/zephyr/boards/espressif/esp32s3_devkitc/Kconfig.defconfig"
```

## build/Kconfig/boards/Kconfig.sysbuild
```kconfig
# Load Sysbuild board Kconfig descriptions.
osource "/Users/dan.tudose/zephyrproject/zephyr/boards/espressif/esp32s3_devkitc/Kconfig.sysbuild"
```
